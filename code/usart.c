#include "usart.h"

void Usart1_Init(void){
	LL_AHB1_GRP1_EnableClock(LL_AHB1_GRP1_PERIPH_GPIOA);
	LL_GPIO_SetPinMode(GPIOA,LL_GPIO_PIN_9,LL_GPIO_MODE_ALTERNATE);
	LL_GPIO_SetAFPin_8_15(GPIOA,LL_GPIO_PIN_9,LL_GPIO_AF_7);
	LL_GPIO_SetPinSpeed(GPIOA,LL_GPIO_PIN_9,LL_GPIO_SPEED_FREQ_HIGH);
	LL_GPIO_SetPinOutputType(GPIOA,LL_GPIO_PIN_9,LL_GPIO_OUTPUT_PUSHPULL);
	LL_GPIO_SetPinPull(GPIOA,LL_GPIO_PIN_9,LL_GPIO_PULL_NO);
	
	LL_GPIO_SetPinMode(GPIOA,LL_GPIO_PIN_10,LL_GPIO_MODE_ALTERNATE);
	LL_GPIO_SetAFPin_8_15(GPIOA,LL_GPIO_PIN_10,LL_GPIO_AF_7);
	LL_GPIO_SetPinSpeed(GPIOA,LL_GPIO_PIN_10,LL_GPIO_SPEED_FREQ_HIGH);
	LL_GPIO_SetPinOutputType(GPIOA,LL_GPIO_PIN_10,LL_GPIO_OUTPUT_PUSHPULL);
	LL_GPIO_SetPinPull(GPIOA,LL_GPIO_PIN_10,LL_GPIO_PULL_NO);
	
	NVIC_SetPriority(USART1_IRQn, 0);  
  NVIC_EnableIRQ(USART1_IRQn);
  
	LL_APB2_GRP1_EnableClock(LL_APB2_GRP1_PERIPH_USART1);
	
	LL_USART_SetTransferDirection(USART1,LL_USART_DIRECTION_TX_RX);
	LL_USART_ConfigCharacter(USART1,LL_USART_DATAWIDTH_8B,LL_USART_PARITY_NONE,LL_USART_STOPBITS_1);
	LL_USART_SetBaudRate(USART1,SystemCoreClock/2,LL_USART_OVERSAMPLING_16,115200);
	
	LL_USART_Enable(USART1);
	
	while((!(LL_USART_IsActiveFlag_TEACK(USART1))) || (!(LL_USART_IsActiveFlag_REACK(USART1))));

	LL_USART_ClearFlag_ORE(USART1);
	LL_USART_EnableIT_RXNE(USART1);
	LL_USART_EnableIT_PE(USART1);
}

void Usart2_Init(void){
	LL_AHB1_GRP1_EnableClock(LL_AHB1_GRP1_PERIPH_GPIOA);
	LL_GPIO_SetPinMode(GPIOA,LL_GPIO_PIN_14,LL_GPIO_MODE_ALTERNATE);
	LL_GPIO_SetAFPin_8_15(GPIOA,LL_GPIO_PIN_14,LL_GPIO_AF_7);
	LL_GPIO_SetPinSpeed(GPIOA,LL_GPIO_PIN_14,LL_GPIO_SPEED_FREQ_HIGH);
	LL_GPIO_SetPinOutputType(GPIOA,LL_GPIO_PIN_14,LL_GPIO_OUTPUT_PUSHPULL);
	LL_GPIO_SetPinPull(GPIOA,LL_GPIO_PIN_14,LL_GPIO_PULL_NO);
	
	LL_GPIO_SetPinMode(GPIOA,LL_GPIO_PIN_15,LL_GPIO_MODE_ALTERNATE);
	LL_GPIO_SetAFPin_8_15(GPIOA,LL_GPIO_PIN_15,LL_GPIO_AF_7);
	LL_GPIO_SetPinSpeed(GPIOA,LL_GPIO_PIN_15,LL_GPIO_SPEED_FREQ_HIGH);
	LL_GPIO_SetPinOutputType(GPIOA,LL_GPIO_PIN_15,LL_GPIO_OUTPUT_PUSHPULL);
	LL_GPIO_SetPinPull(GPIOA,LL_GPIO_PIN_15,LL_GPIO_PULL_NO);
	
	NVIC_SetPriority(USART2_IRQn, 0);  
  NVIC_EnableIRQ(USART2_IRQn);
  
	LL_APB1_GRP1_EnableClock(LL_APB1_GRP1_PERIPH_USART2);
	
	LL_USART_SetTransferDirection(USART2,LL_USART_DIRECTION_TX_RX);
	LL_USART_ConfigCharacter(USART2,LL_USART_DATAWIDTH_8B,LL_USART_PARITY_NONE,LL_USART_STOPBITS_1);
	LL_USART_SetBaudRate(USART2,SystemCoreClock/2,LL_USART_OVERSAMPLING_16,115200);
	
	LL_USART_Enable(USART2);
	
	while((!(LL_USART_IsActiveFlag_TEACK(USART2))) || (!(LL_USART_IsActiveFlag_REACK(USART2))));

	LL_USART_ClearFlag_ORE(USART2);
	LL_USART_EnableIT_RXNE(USART2);
	LL_USART_EnableIT_PE(USART2);
}

void Send_Buffer(char* buffer){
	int ubSend=0;
	while(buffer[ubSend]!='\0'){
		while(!LL_USART_IsActiveFlag_TXE(USART1));
		LL_USART_TransmitData8(USART1, buffer[ubSend]);
		ubSend++;
	}
	while (!LL_USART_IsActiveFlag_TC(USART1));
}

void Send_Buffer2(char* buffer){
	int ubSend=0;
	while(buffer[ubSend]!='\0'){
		while(!LL_USART_IsActiveFlag_TXE(USART2));
		LL_USART_TransmitData8(USART2, buffer[ubSend]);
		ubSend++;
	}
	while (!LL_USART_IsActiveFlag_TC(USART2));
}
